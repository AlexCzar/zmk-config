## config/west.yml
```yaml
manifest:
  remotes:
    - name: zmkfirmware
      url-base: https://github.com/zmkfirmware
    - name: z35
      url-base: https://github.com/petejohanson
  projects:
    - name: zmk
      remote: z35
      revision: core/zephyr-3.5-update
      import: app/west.yml
  self:
    path: config
```
